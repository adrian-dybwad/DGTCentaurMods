## CMakeLists.txt
```
# SPDX-License-Identifier: Apache-2.0
# Millennium BLE Proxy Firmware for nRF52840 USB Dongle
#
# This firmware acts as a BLE man-in-the-middle proxy between a chess app
# and a real Millennium ChessLink board. All traffic is forwarded bidirectionally
# and streamed over USB CDC for analysis on the host.

cmake_minimum_required(VERSION 3.20.0)
find_package(Zephyr REQUIRED HINTS $ENV{ZEPHYR_BASE})
project(millennium_proxy)

target_sources(app PRIVATE
    src/main.c
    src/ble_central.c
    src/ble_peripheral.c
    src/usb_console.c
    src/protocol.c
)
```

## prj.conf
```kconfig
# Millennium BLE Proxy - Zephyr Configuration
# Target: nRF52840 USB Dongle

# Enable logging
CONFIG_LOG=y
CONFIG_LOG_DEFAULT_LEVEL=3

# Bluetooth configuration
CONFIG_BT=y
CONFIG_BT_LOG_LEVEL_INF=y

# Central role (to connect to real Millennium board)
CONFIG_BT_CENTRAL=y
CONFIG_BT_GATT_CLIENT=y

# Peripheral role (to accept connections from chess app)
CONFIG_BT_PERIPHERAL=y
CONFIG_BT_GATT_DYNAMIC_DB=y

# Allow simultaneous central + peripheral
CONFIG_BT_MAX_CONN=2

# Increase buffer sizes for BLE data
CONFIG_BT_L2CAP_TX_MTU=247
CONFIG_BT_BUF_ACL_RX_SIZE=251
CONFIG_BT_BUF_ACL_TX_SIZE=251

# GATT configuration
CONFIG_BT_GATT_CACHING=n

# Device name (appears to chess app)
CONFIG_BT_DEVICE_NAME="MILLENNIUM CHESS"
CONFIG_BT_DEVICE_NAME_DYNAMIC=y

# USB CDC ACM - use NEW stack only
CONFIG_USB_DEVICE_STACK_NEXT=y
CONFIG_USBD_CDC_ACM_CLASS=y

# Console over USB CDC
CONFIG_CONSOLE=y
CONFIG_SERIAL=y
CONFIG_UART_CONSOLE=y
CONFIG_UART_LINE_CTRL=y

# System configuration
CONFIG_HEAP_MEM_POOL_SIZE=4096
CONFIG_MAIN_STACK_SIZE=2048
CONFIG_SYSTEM_WORKQUEUE_STACK_SIZE=2048

# Enable GPIO for LED status
CONFIG_GPIO=y

# Timing
CONFIG_SYS_CLOCK_TICKS_PER_SEC=1000

# C library
CONFIG_PICOLIBC=y
```

## boards/nrf52840dongle.overlay
```dts
/* Device tree overlay for nRF52840 USB Dongle */

/ {
    chosen {
        zephyr,console = &cdc_acm_uart0;
        zephyr,shell-uart = &cdc_acm_uart0;
    };
};

&zephyr_udc0 {
    cdc_acm_uart0: cdc_acm_uart0 {
        compatible = "zephyr,cdc-acm-uart";
    };
};
```

## src/main.c
```c
/**
 * @file main.c
 * @brief Millennium BLE Proxy - Main application
 *
 * BLE man-in-the-middle proxy for Millennium ChessLink protocol analysis.
 *
 * Architecture:
 * - Central role: Connects to real Millennium board
 * - Peripheral role: Accepts connections from chess app
 * - USB CDC: Streams all traffic to host for real-time analysis
 *
 * Data flow:
 * - App writes to proxy RX -> Forward to real board RX
 * - Real board notifies proxy TX -> Forward to app TX
 *
 * The proxy is transparent to both the app and the board.
 */

#include <zephyr/kernel.h>
#include <zephyr/bluetooth/bluetooth.h>
#include <zephyr/drivers/gpio.h>
#include <zephyr/logging/log.h>

#include "ble_central.h"
#include "ble_peripheral.h"
#include "usb_console.h"
#include "protocol.h"

#include <string.h>

LOG_MODULE_REGISTER(main, LOG_LEVEL_INF);

/* LED for status indication (nRF52840 dongle has LED on P0.06) */
#define LED0_NODE DT_ALIAS(led0)
#if DT_NODE_EXISTS(LED0_NODE)
static const struct gpio_dt_spec led = GPIO_DT_SPEC_GET(LED0_NODE, gpios);
static bool led_available = false;
#endif

/* Forward declarations */
static void on_data_from_board(const uint8_t *data, size_t len);
static void on_data_from_app(const uint8_t *data, size_t len);

/**
 * Data received from real board (via central role).
 *
 * Forward to chess app via peripheral TX notifications.
 * Also log and decode for USB console.
 */
static void on_data_from_board(const uint8_t *data, size_t len)
{
    /* Decode for human-readable output */
    protocol_decode_and_log(DIR_BOARD_TO_APP, data, len);
    
    /* Forward to app */
    if (ble_peripheral_is_connected()) {
        int err = ble_peripheral_send(data, len);
        if (err) {
            LOG_ERR("Failed to forward to app: %d", err);
        }
    } else {
        LOG_WRN("App not connected, dropping board data");
    }
}

/**
 * Data received from chess app (via peripheral RX).
 *
 * Forward to real board via central RX write.
 * Also log and decode for USB console.
 */
static void on_data_from_app(const uint8_t *data, size_t len)
{
    /* Decode for human-readable output */
    protocol_decode_and_log(DIR_APP_TO_BOARD, data, len);
    
    /* Forward to real board */
    if (ble_central_is_connected()) {
        int err = ble_central_send(data, len);
        if (err) {
            LOG_ERR("Failed to forward to board: %d", err);
        }
    } else {
        LOG_WRN("Board not connected, dropping app data");
    }
}

/**
 * Initialize LED for status indication.
 */
static void led_init(void)
{
#if DT_NODE_EXISTS(LED0_NODE)
    if (!gpio_is_ready_dt(&led)) {
        LOG_WRN("LED device not ready");
        return;
    }
    
    int ret = gpio_pin_configure_dt(&led, GPIO_OUTPUT_INACTIVE);
    if (ret < 0) {
        LOG_WRN("Failed to configure LED: %d", ret);
        return;
    }
    
    led_available = true;
    LOG_INF("LED initialized");
#endif
}

/**
 * Update LED based on connection status.
 *
 * - Off: No connections
 * - Slow blink: Scanning/advertising only
 * - Fast blink: One connection (central or peripheral)
 * - Solid: Both connections established (proxy active)
 */
static void led_update(bool board_connected, bool app_connected)
{
#if DT_NODE_EXISTS(LED0_NODE)
    if (!led_available) {
        return;
    }
    
    static uint32_t last_toggle = 0;
    static bool led_state = false;
    uint32_t now = k_uptime_get_32();
    
    if (board_connected && app_connected) {
        /* Solid on - proxy fully active */
        gpio_pin_set_dt(&led, 1);
    } else if (board_connected || app_connected) {
        /* Fast blink - one connection */
        if (now - last_toggle >= 200) {
            led_state = !led_state;
            gpio_pin_set_dt(&led, led_state);
            last_toggle = now;
        }
    } else {
        /* Slow blink - scanning/advertising */
        if (now - last_toggle >= 1000) {
            led_state = !led_state;
            gpio_pin_set_dt(&led, led_state);
            last_toggle = now;
        }
    }
#endif
}

/**
 * Print startup banner.
 */
static void print_banner(void)
{
    usb_console_printf("\r\n");
    usb_console_printf("============================================\r\n");
    usb_console_printf("  Millennium BLE Proxy\r\n");
    usb_console_printf("  nRF52840 USB Dongle Firmware\r\n");
    usb_console_printf("============================================\r\n");
    usb_console_printf("\r\n");
    usb_console_printf("This proxy sits between a chess app and a\r\n");
    usb_console_printf("real Millennium ChessLink board, logging\r\n");
    usb_console_printf("all BLE traffic for protocol analysis.\r\n");
    usb_console_printf("\r\n");
    usb_console_printf("Traffic format:\r\n");
    usb_console_printf("  [timestamp] APP->BOARD: xx xx xx ...\r\n");
    usb_console_printf("  [timestamp] BOARD->APP: xx xx xx ...\r\n");
    usb_console_printf("  [timestamp] STATUS: status message\r\n");
    usb_console_printf("\r\n");
    usb_console_printf("============================================\r\n");
    usb_console_printf("\r\n");
}

int main(void)
{
    int err;
    
    LOG_INF("Millennium BLE Proxy starting...");
    
    /* Initialize LED */
    led_init();
    
    /* Initialize USB console */
    err = usb_console_init();
    if (err) {
        LOG_ERR("USB console init failed: %d", err);
        /* Continue anyway - we can still proxy */
    }
    
    /* Print startup banner */
    print_banner();
    
    /* Initialize Bluetooth */
    err = bt_enable(NULL);
    if (err) {
        LOG_ERR("Bluetooth init failed: %d", err);
        usb_console_log_status("ERROR: Bluetooth init failed");
        return err;
    }
    
    LOG_INF("Bluetooth initialized");
    usb_console_log_status("Bluetooth initialized");
    
    /* Initialize peripheral role (for chess app connections) */
    err = ble_peripheral_init(on_data_from_app);
    if (err) {
        LOG_ERR("Peripheral init failed: %d", err);
        usb_console_log_status("ERROR: Peripheral init failed");
        return err;
    }
    
    /* Initialize central role (for real board connection) */
    err = ble_central_init(on_data_from_board);
    if (err) {
        LOG_ERR("Central init failed: %d", err);
        usb_console_log_status("ERROR: Central init failed");
        return err;
    }
    
    /* Start advertising (for chess app to find us) */
    err = ble_peripheral_start_advertising();
    if (err) {
        LOG_ERR("Advertising start failed: %d", err);
        usb_console_log_status("ERROR: Advertising failed");
        return err;
    }
    
    /* Start scanning for real Millennium board */
    err = ble_central_start_scan("MILLENNIUM");
    if (err) {
        LOG_ERR("Scan start failed: %d", err);
        usb_console_log_status("ERROR: Scanning failed");
        return err;
    }
    
    usb_console_log_status("Proxy initialized - scanning for board, advertising for app");
    
    /* Main loop - update LED status */
    while (1) {
        bool board_conn = ble_central_is_connected();
        bool app_conn = ble_peripheral_is_connected();
        
        led_update(board_conn, app_conn);
        
        k_sleep(K_MSEC(50));
    }
    
    return 0;
}
```

## src/ble_central.c
```c
/**
 * @file ble_central.c
 * @brief BLE Central role implementation
 *
 * Scans for and connects to the real Millennium ChessLink board.
 * Subscribes to TX notifications and forwards data via callback.
 */

#include "ble_central.h"
#include "protocol.h"
#include "usb_console.h"

#include <zephyr/kernel.h>
#include <zephyr/bluetooth/bluetooth.h>
#include <zephyr/bluetooth/conn.h>
#include <zephyr/bluetooth/gatt.h>
#include <zephyr/bluetooth/uuid.h>
#include <zephyr/logging/log.h>

#include <string.h>
#include <ctype.h>

LOG_MODULE_REGISTER(ble_central, LOG_LEVEL_INF);

/* Connection state */
static struct bt_conn *real_board_conn = NULL;
static bool connected = false;
static bool subscribed = false;

/* GATT handles for characteristics */
static uint16_t tx_handle = 0;
static uint16_t tx_ccc_handle = 0;
static uint16_t rx_handle = 0;

/* Callback for received data */
static central_rx_callback_t rx_callback = NULL;

/* Target device name filter (optional) */
static char target_name_filter[32] = {0};

/* GATT subscription state */
static struct bt_gatt_subscribe_params subscribe_params;

/* Discovery state */
static struct bt_gatt_discover_params discover_params;

/* UUID for filtering scan results */
static struct bt_uuid_128 millennium_uuid = BT_UUID_INIT_128(MILLENNIUM_SERVICE_UUID);

/**
 * Case-insensitive string comparison (first n chars).
 */
static int strnicmp(const char *s1, const char *s2, size_t n)
{
    for (size_t i = 0; i < n; i++) {
        char c1 = s1[i];
        char c2 = s2[i];
        
        if (c1 >= 'A' && c1 <= 'Z') c1 += 32;
        if (c2 >= 'A' && c2 <= 'Z') c2 += 32;
        
        if (c1 != c2) return c1 - c2;
        if (c1 == '\0') return 0;
    }
    return 0;
}

/**
 * Notification callback for TX characteristic.
 *
 * Called when real board sends data via notifications.
 */
static uint8_t notify_callback(struct bt_conn *conn,
                               struct bt_gatt_subscribe_params *params,
                               const void *data, uint16_t length)
{
    if (!data) {
        LOG_WRN("Unsubscribed from TX notifications");
        subscribed = false;
        return BT_GATT_ITER_STOP;
    }
    
    /* Log raw traffic */
    usb_console_log_traffic(DIR_BOARD_TO_APP, data, length);
    
    /* Forward to peripheral side */
    if (rx_callback) {
        rx_callback(data, length);
    }
    
    return BT_GATT_ITER_CONTINUE;
}

/**
 * Subscribe to TX characteristic notifications.
 */
static int subscribe_to_tx(void)
{
    if (tx_handle == 0 || tx_ccc_handle == 0) {
        LOG_ERR("TX handles not discovered");
        return -EINVAL;
    }
    
    subscribe_params.notify = notify_callback;
    subscribe_params.value_handle = tx_handle;
    subscribe_params.ccc_handle = tx_ccc_handle;
    subscribe_params.value = BT_GATT_CCC_NOTIFY;
    
    int err = bt_gatt_subscribe(real_board_conn, &subscribe_params);
    if (err) {
        LOG_ERR("Subscribe failed: %d", err);
        return err;
    }
    
    LOG_INF("Subscribed to TX notifications");
    usb_console_log_status("Subscribed to real board notifications");
    subscribed = true;
    
    return 0;
}

/**
 * GATT discovery callback.
 *
 * Called for each discovered attribute during service discovery.
 */
static uint8_t discover_callback(struct bt_conn *conn,
                                 const struct bt_gatt_attr *attr,
                                 struct bt_gatt_discover_params *params)
{
    if (!attr) {
        LOG_INF("Discovery complete");
        
        /* Now subscribe to TX notifications */
        if (tx_handle != 0) {
            subscribe_to_tx();
        } else {
            LOG_ERR("TX characteristic not found");
        }
        
        return BT_GATT_ITER_STOP;
    }
    
    char uuid_str[64];
    bt_uuid_to_str(attr->uuid, uuid_str, sizeof(uuid_str));
    LOG_DBG("Discovered: handle=%u, uuid=%s", attr->handle, uuid_str);
    
    /* Check for TX characteristic */
    if (bt_uuid_cmp(attr->uuid, BT_UUID_MILLENNIUM_TX) == 0) {
        tx_handle = attr->handle;
        LOG_INF("Found TX characteristic: handle=%u", tx_handle);
    }
    
    /* Check for RX characteristic */
    if (bt_uuid_cmp(attr->uuid, BT_UUID_MILLENNIUM_RX) == 0) {
        rx_handle = attr->handle;
        LOG_INF("Found RX characteristic: handle=%u", rx_handle);
    }
    
    /* Check for CCC descriptor (for notifications) */
    if (bt_uuid_cmp(attr->uuid, BT_UUID_GATT_CCC) == 0) {
        /* Assume this is for the most recently discovered characteristic */
        if (tx_handle != 0 && tx_ccc_handle == 0) {
            tx_ccc_handle = attr->handle;
            LOG_INF("Found TX CCC: handle=%u", tx_ccc_handle);
        }
    }
    
    return BT_GATT_ITER_CONTINUE;
}

/**
 * Start GATT service discovery.
 */
static int discover_services(void)
{
    memset(&discover_params, 0, sizeof(discover_params));
    
    discover_params.uuid = BT_UUID_MILLENNIUM_SERVICE;
    discover_params.func = discover_callback;
    discover_params.start_handle = BT_ATT_FIRST_ATTRIBUTE_HANDLE;
    discover_params.end_handle = BT_ATT_LAST_ATTRIBUTE_HANDLE;
    discover_params.type = BT_GATT_DISCOVER_ATTRIBUTE;
    
    int err = bt_gatt_discover(real_board_conn, &discover_params);
    if (err) {
        LOG_ERR("Discovery start failed: %d", err);
        return err;
    }
    
    LOG_INF("Started service discovery");
    return 0;
}

/**
 * Connection callback.
 */
static void connected_callback(struct bt_conn *conn, uint8_t err)
{
    if (err) {
        LOG_ERR("Connection failed: %d", err);
        real_board_conn = NULL;
        connected = false;
        usb_console_log_status("Failed to connect to real board");
        return;
    }
    
    LOG_INF("Connected to real Millennium board");
    usb_console_log_status("Connected to real Millennium board");
    
    connected = true;
    
    /* Start service discovery */
    discover_services();
}

/**
 * Disconnection callback.
 */
static void disconnected_callback(struct bt_conn *conn, uint8_t reason)
{
    char msg[64];
    snprintf(msg, sizeof(msg), "Disconnected from real board (reason: %u)", reason);
    
    LOG_INF("Disconnected: reason=%u", reason);
    usb_console_log_status(msg);
    
    if (real_board_conn) {
        bt_conn_unref(real_board_conn);
        real_board_conn = NULL;
    }
    
    connected = false;
    subscribed = false;
    tx_handle = 0;
    tx_ccc_handle = 0;
    rx_handle = 0;
    
    /* Restart scanning */
    ble_central_start_scan(target_name_filter[0] ? target_name_filter : NULL);
}

/* Connection callbacks */
BT_CONN_CB_DEFINE(conn_callbacks) = {
    .connected = connected_callback,
    .disconnected = disconnected_callback,
};

/**
 * Check if scan data matches Millennium board.
 */
static bool is_millennium_device(struct bt_data *data, void *user_data)
{
    bool *found = user_data;
    
    switch (data->type) {
    case BT_DATA_UUID128_ALL:
    case BT_DATA_UUID128_SOME:
        /* Check for Millennium service UUID */
        if (data->data_len >= 16) {
            if (memcmp(data->data, millennium_uuid.val, 16) == 0) {
                *found = true;
                return false;  /* Stop parsing */
            }
        }
        break;
    
    case BT_DATA_NAME_COMPLETE:
    case BT_DATA_NAME_SHORTENED:
        /* Check for "MILLENNIUM" in name */
        if (data->data_len >= 10) {
            if (strnicmp((const char *)data->data, "MILLENNIUM", 10) == 0) {
                *found = true;
                return false;
            }
        }
        break;
    }
    
    return true;  /* Continue parsing */
}

/**
 * Scan callback.
 */
static void scan_callback(const bt_addr_le_t *addr, int8_t rssi,
                          uint8_t type, struct net_buf_simple *ad)
{
    /* Check if this is a Millennium device */
    bool is_millennium = false;
    bt_data_parse(ad, is_millennium_device, &is_millennium);
    
    if (!is_millennium) {
        return;
    }
    
    /* Stop scanning */
    bt_le_scan_stop();
    
    char addr_str[BT_ADDR_LE_STR_LEN];
    bt_addr_le_to_str(addr, addr_str, sizeof(addr_str));
    
    char msg[80];
    snprintf(msg, sizeof(msg), "Found Millennium board: %s (RSSI: %d)", addr_str, rssi);
    LOG_INF("%s", msg);
    usb_console_log_status(msg);
    
    /* Connect */
    struct bt_conn_le_create_param create_param = BT_CONN_LE_CREATE_PARAM_INIT(
        BT_CONN_LE_OPT_NONE,
        BT_GAP_SCAN_FAST_INTERVAL,
        BT_GAP_SCAN_FAST_WINDOW
    );
    
    struct bt_le_conn_param conn_param = BT_LE_CONN_PARAM_INIT(
        24, 40,  /* interval min/max (30-50ms) */
        0,       /* latency */
        400      /* timeout (4s) */
    );
    
    int err = bt_conn_le_create(addr, &create_param, &conn_param, &real_board_conn);
    if (err) {
        LOG_ERR("Connect failed: %d", err);
        usb_console_log_status("Failed to initiate connection");
        /* Restart scanning */
        ble_central_start_scan(target_name_filter[0] ? target_name_filter : NULL);
    }
}

int ble_central_init(central_rx_callback_t callback)
{
    rx_callback = callback;
    
    LOG_INF("BLE central initialized");
    return 0;
}

int ble_central_start_scan(const char *target_name)
{
    if (connected) {
        LOG_WRN("Already connected, not scanning");
        return 0;
    }
    
    if (target_name) {
        strncpy(target_name_filter, target_name, sizeof(target_name_filter) - 1);
    } else {
        target_name_filter[0] = '\0';
    }
    
    struct bt_le_scan_param scan_param = {
        .type = BT_LE_SCAN_TYPE_ACTIVE,
        .options = BT_LE_SCAN_OPT_NONE,
        .interval = BT_GAP_SCAN_FAST_INTERVAL,
        .window = BT_GAP_SCAN_FAST_WINDOW,
    };
    
    int err = bt_le_scan_start(&scan_param, scan_callback);
    if (err) {
        LOG_ERR("Scan start failed: %d", err);
        return err;
    }
    
    LOG_INF("Scanning for real Millennium board...");
    usb_console_log_status("Scanning for real Millennium board...");
    
    return 0;
}

int ble_central_stop_scan(void)
{
    return bt_le_scan_stop();
}

bool ble_central_is_connected(void)
{
    return connected && subscribed;
}

int ble_central_send(const uint8_t *data, size_t len)
{
    if (!connected || !real_board_conn) {
        LOG_WRN("Not connected to real board");
        return -ENOTCONN;
    }
    
    if (rx_handle == 0) {
        LOG_ERR("RX handle not discovered");
        return -EINVAL;
    }
    
    /* Log traffic */
    usb_console_log_traffic(DIR_APP_TO_BOARD, data, len);
    
    int err = bt_gatt_write_without_response(real_board_conn, rx_handle,
                                              data, len, false);
    if (err) {
        LOG_ERR("Write failed: %d", err);
        return err;
    }
    
    return 0;
}

int ble_central_disconnect(void)
{
    if (!connected || !real_board_conn) {
        return 0;
    }
    
    return bt_conn_disconnect(real_board_conn, BT_HCI_ERR_REMOTE_USER_TERM_CONN);
}
```

## src/ble_central.h
```c
/**
 * @file ble_central.h
 * @brief BLE Central role - connects to real Millennium board
 *
 * Handles scanning for and connecting to the real Millennium ChessLink board.
 * Discovers services/characteristics and subscribes to notifications.
 * Forwards all received data to the peripheral side for relay to the app.
 */

#ifndef BLE_CENTRAL_H
#define BLE_CENTRAL_H

#include <stdbool.h>
#include <stdint.h>
#include <stddef.h>

/**
 * Callback for data received from real board.
 *
 * Called when data is received from the real Millennium board's TX characteristic.
 * This data should be forwarded to the chess app via the peripheral side.
 *
 * @param data Pointer to received data
 * @param len Length of data
 */
typedef void (*central_rx_callback_t)(const uint8_t *data, size_t len);

/**
 * Initialize BLE central role.
 *
 * Sets up scanning and connection handling for the real Millennium board.
 *
 * @param rx_callback Callback for data received from real board
 * @return 0 on success, negative errno on failure
 */
int ble_central_init(central_rx_callback_t rx_callback);

/**
 * Start scanning for real Millennium board.
 *
 * Scans for devices advertising the Millennium service UUID.
 *
 * @param target_name Optional device name to filter (NULL for any Millennium)
 * @return 0 on success, negative errno on failure
 */
int ble_central_start_scan(const char *target_name);

/**
 * Stop scanning.
 *
 * @return 0 on success, negative errno on failure
 */
int ble_central_stop_scan(void);

/**
 * Check if connected to real board.
 *
 * @return true if connected to real Millennium board
 */
bool ble_central_is_connected(void);

/**
 * Send data to real board.
 *
 * Writes data to the real Millennium board's RX characteristic.
 * This is used to forward commands from the chess app to the real board.
 *
 * @param data Pointer to data buffer
 * @param len Length of data
 * @return 0 on success, negative errno on failure
 */
int ble_central_send(const uint8_t *data, size_t len);

/**
 * Disconnect from real board.
 *
 * @return 0 on success, negative errno on failure
 */
int ble_central_disconnect(void);

#endif /* BLE_CENTRAL_H */
```

## src/ble_peripheral.c
```c
/**
 * @file ble_peripheral.c
 * @brief BLE Peripheral role implementation
 *
 * Advertises as a Millennium ChessLink board and exposes matching GATT services.
 * The chess app connects here thinking it's the real board.
 */

#include "ble_peripheral.h"
#include "protocol.h"
#include "usb_console.h"

#include <zephyr/kernel.h>
#include <zephyr/bluetooth/bluetooth.h>
#include <zephyr/bluetooth/conn.h>
#include <zephyr/bluetooth/gatt.h>
#include <zephyr/bluetooth/uuid.h>
#include <zephyr/logging/log.h>

#include <string.h>

LOG_MODULE_REGISTER(ble_peripheral, LOG_LEVEL_INF);

/* Connection state */
static struct bt_conn *app_conn = NULL;
static bool connected = false;
static bool tx_notifications_enabled = false;

/* Callback for received data from app */
static peripheral_rx_callback_t rx_callback = NULL;

/* Characteristic values (buffers for reads) */
static uint8_t config_value[20] = {0};
static uint8_t tx_value[244] = {0};  /* Max BLE payload */
static uint16_t tx_value_len = 0;

/**
 * TX characteristic CCC changed callback.
 *
 * Called when the app enables/disables notifications on TX.
 */
static void tx_ccc_changed(const struct bt_gatt_attr *attr, uint16_t value)
{
    tx_notifications_enabled = (value == BT_GATT_CCC_NOTIFY);
    
    LOG_INF("TX notifications %s", tx_notifications_enabled ? "enabled" : "disabled");
    
    if (tx_notifications_enabled) {
        usb_console_log_status("App subscribed to TX notifications");
    } else {
        usb_console_log_status("App unsubscribed from TX notifications");
    }
}

/**
 * RX characteristic write callback.
 *
 * Called when the app writes data to send to the board.
 */
static ssize_t rx_write_callback(struct bt_conn *conn,
                                  const struct bt_gatt_attr *attr,
                                  const void *buf, uint16_t len,
                                  uint16_t offset, uint8_t flags)
{
    if (offset > 0) {
        return BT_GATT_ERR(BT_ATT_ERR_INVALID_OFFSET);
    }
    
    LOG_DBG("RX write: %u bytes", len);
    
    /* Forward to central side (to send to real board) */
    if (rx_callback && len > 0) {
        rx_callback(buf, len);
    }
    
    return len;
}

/**
 * Config characteristic read callback.
 */
static ssize_t config_read_callback(struct bt_conn *conn,
                                     const struct bt_gatt_attr *attr,
                                     void *buf, uint16_t len, uint16_t offset)
{
    return bt_gatt_attr_read(conn, attr, buf, len, offset,
                             config_value, sizeof(config_value));
}

/**
 * Config characteristic write callback.
 */
static ssize_t config_write_callback(struct bt_conn *conn,
                                      const struct bt_gatt_attr *attr,
                                      const void *buf, uint16_t len,
                                      uint16_t offset, uint8_t flags)
{
    if (offset > 0) {
        return BT_GATT_ERR(BT_ATT_ERR_INVALID_OFFSET);
    }
    
    if (len > sizeof(config_value)) {
        return BT_GATT_ERR(BT_ATT_ERR_INVALID_ATTRIBUTE_LEN);
    }
    
    memcpy(config_value, buf, len);
    LOG_DBG("Config write: %u bytes", len);
    
    return len;
}

/**
 * TX characteristic read callback.
 */
static ssize_t tx_read_callback(struct bt_conn *conn,
                                 const struct bt_gatt_attr *attr,
                                 void *buf, uint16_t len, uint16_t offset)
{
    return bt_gatt_attr_read(conn, attr, buf, len, offset,
                             tx_value, tx_value_len);
}

/**
 * Notify1 and Notify2 CCC changed callbacks.
 */
static void notify1_ccc_changed(const struct bt_gatt_attr *attr, uint16_t value)
{
    LOG_DBG("Notify1 CCC changed: %u", value);
}

static void notify2_ccc_changed(const struct bt_gatt_attr *attr, uint16_t value)
{
    LOG_DBG("Notify2 CCC changed: %u", value);
}

/*
 * GATT Service Definition
 *
 * Matches the real Millennium board's service structure:
 * - Service: 49535343-fe7d-4ae5-8fa9-9fafd205e455
 *   - Config:  49535343-6daa-4d02-abf6-19569aca69fe (READ/WRITE)
 *   - Notify1: 49535343-aca3-481c-91ec-d85e28a60318 (WRITE/NOTIFY)
 *   - TX:      49535343-1e4d-4bd9-ba61-23c647249616 (READ/WRITE/WRITE_NR/NOTIFY)
 *   - RX:      49535343-8841-43f4-a8d4-ecbe34729bb3 (WRITE/WRITE_NR)
 *   - Notify2: 49535343-026e-3a9b-954c-97daef17e26e (WRITE/NOTIFY)
 */
BT_GATT_SERVICE_DEFINE(millennium_svc,
    /* Service declaration */
    BT_GATT_PRIMARY_SERVICE(BT_UUID_MILLENNIUM_SERVICE),
    
    /* Config characteristic */
    BT_GATT_CHARACTERISTIC(BT_UUID_MILLENNIUM_CONFIG,
        BT_GATT_CHRC_READ | BT_GATT_CHRC_WRITE,
        BT_GATT_PERM_READ | BT_GATT_PERM_WRITE,
        config_read_callback, config_write_callback, NULL),
    
    /* Notify1 characteristic */
    BT_GATT_CHARACTERISTIC(BT_UUID_MILLENNIUM_NOTIFY1,
        BT_GATT_CHRC_WRITE | BT_GATT_CHRC_NOTIFY,
        BT_GATT_PERM_WRITE,
        NULL, NULL, NULL),
    BT_GATT_CCC(notify1_ccc_changed, BT_GATT_PERM_READ | BT_GATT_PERM_WRITE),
    
    /* TX characteristic (main data output) */
    BT_GATT_CHARACTERISTIC(BT_UUID_MILLENNIUM_TX,
        BT_GATT_CHRC_READ | BT_GATT_CHRC_WRITE | 
        BT_GATT_CHRC_WRITE_WITHOUT_RESP | BT_GATT_CHRC_NOTIFY,
        BT_GATT_PERM_READ | BT_GATT_PERM_WRITE,
        tx_read_callback, NULL, NULL),
    BT_GATT_CCC(tx_ccc_changed, BT_GATT_PERM_READ | BT_GATT_PERM_WRITE),
    
    /* RX characteristic (main data input from app) */
    BT_GATT_CHARACTERISTIC(BT_UUID_MILLENNIUM_RX,
        BT_GATT_CHRC_WRITE | BT_GATT_CHRC_WRITE_WITHOUT_RESP,
        BT_GATT_PERM_WRITE,
        NULL, rx_write_callback, NULL),
    
    /* Notify2 characteristic */
    BT_GATT_CHARACTERISTIC(BT_UUID_MILLENNIUM_NOTIFY2,
        BT_GATT_CHRC_WRITE | BT_GATT_CHRC_NOTIFY,
        BT_GATT_PERM_WRITE,
        NULL, NULL, NULL),
    BT_GATT_CCC(notify2_ccc_changed, BT_GATT_PERM_READ | BT_GATT_PERM_WRITE),
);

/**
 * Connection callback.
 */
static void peripheral_connected(struct bt_conn *conn, uint8_t err)
{
    /* Check if this is a connection we initiated (central role) */
    struct bt_conn_info info;
    bt_conn_get_info(conn, &info);
    
    if (info.role != BT_CONN_ROLE_PERIPHERAL) {
        return;  /* Not a peripheral connection */
    }
    
    if (err) {
        LOG_ERR("App connection failed: %d", err);
        return;
    }
    
    app_conn = bt_conn_ref(conn);
    connected = true;
    
    char addr_str[BT_ADDR_LE_STR_LEN];
    bt_addr_le_to_str(bt_conn_get_dst(conn), addr_str, sizeof(addr_str));
    
    char msg[80];
    snprintf(msg, sizeof(msg), "Chess app connected: %s", addr_str);
    LOG_INF("%s", msg);
    usb_console_log_status(msg);
}

/**
 * Disconnection callback.
 */
static void peripheral_disconnected(struct bt_conn *conn, uint8_t reason)
{
    if (conn != app_conn) {
        return;  /* Not our connection */
    }
    
    char msg[64];
    snprintf(msg, sizeof(msg), "Chess app disconnected (reason: %u)", reason);
    LOG_INF("%s", msg);
    usb_console_log_status(msg);
    
    bt_conn_unref(app_conn);
    app_conn = NULL;
    connected = false;
    tx_notifications_enabled = false;
    
    /* Restart advertising */
    ble_peripheral_start_advertising();
}

/* Connection callbacks structure */
static struct bt_conn_cb peripheral_conn_callbacks = {
    .connected = peripheral_connected,
    .disconnected = peripheral_disconnected,
};

/* Advertising data */
static const struct bt_data ad[] = {
    BT_DATA_BYTES(BT_DATA_FLAGS, (BT_LE_AD_GENERAL | BT_LE_AD_NO_BREDR)),
    BT_DATA(BT_DATA_NAME_COMPLETE, "MILLENNIUM CHESS", 16),
};

/* Scan response data with service UUID */
static const struct bt_data sd[] = {
    BT_DATA_BYTES(BT_DATA_UUID128_ALL, MILLENNIUM_SERVICE_UUID),
};

int ble_peripheral_init(peripheral_rx_callback_t callback)
{
    rx_callback = callback;
    
    bt_conn_cb_register(&peripheral_conn_callbacks);
    
    LOG_INF("BLE peripheral initialized");
    return 0;
}

int ble_peripheral_start_advertising(void)
{
    /* Use connectable advertising parameters */
    struct bt_le_adv_param adv_param = BT_LE_ADV_PARAM_INIT(
        BT_LE_ADV_OPT_CONN,
        BT_GAP_ADV_FAST_INT_MIN_2,
        BT_GAP_ADV_FAST_INT_MAX_2,
        NULL
    );
    
    int err = bt_le_adv_start(&adv_param, ad, ARRAY_SIZE(ad), sd, ARRAY_SIZE(sd));
    if (err) {
        LOG_ERR("Advertising start failed: %d", err);
        return err;
    }
    
    LOG_INF("Advertising as 'MILLENNIUM CHESS'");
    usb_console_log_status("Advertising as 'MILLENNIUM CHESS' - waiting for app...");
    
    return 0;
}

int ble_peripheral_stop_advertising(void)
{
    return bt_le_adv_stop();
}

bool ble_peripheral_is_connected(void)
{
    return connected && tx_notifications_enabled;
}

int ble_peripheral_send(const uint8_t *data, size_t len)
{
    if (!connected || !app_conn) {
        LOG_WRN("No app connected");
        return -ENOTCONN;
    }
    
    if (!tx_notifications_enabled) {
        LOG_WRN("TX notifications not enabled");
        return -EINVAL;
    }
    
    /* Store value for reads */
    tx_value_len = MIN(len, sizeof(tx_value));
    memcpy(tx_value, data, tx_value_len);
    
    /* Get TX characteristic attribute */
    const struct bt_gatt_attr *tx_attr = &millennium_svc.attrs[6];  /* TX char value */
    
    int err = bt_gatt_notify(app_conn, tx_attr, data, len);
    if (err) {
        LOG_ERR("Notify failed: %d", err);
        return err;
    }
    
    return 0;
}

int ble_peripheral_disconnect(void)
{
    if (!connected || !app_conn) {
        return 0;
    }
    
    return bt_conn_disconnect(app_conn, BT_HCI_ERR_REMOTE_USER_TERM_CONN);
}
```

## src/ble_peripheral.h
```c
/**
 * @file ble_peripheral.h
 * @brief BLE Peripheral role - accepts connections from chess app
 *
 * Advertises as a Millennium ChessLink board for chess apps to connect to.
 * Exposes the same GATT services and characteristics as the real board.
 * Forwards all received commands to the central side for relay to the real board.
 */

#ifndef BLE_PERIPHERAL_H
#define BLE_PERIPHERAL_H

#include <stdbool.h>
#include <stdint.h>
#include <stddef.h>

/**
 * Callback for data received from chess app.
 *
 * Called when the chess app writes to the RX characteristic.
 * This data should be forwarded to the real board via the central side.
 *
 * @param data Pointer to received data
 * @param len Length of data
 */
typedef void (*peripheral_rx_callback_t)(const uint8_t *data, size_t len);

/**
 * Initialize BLE peripheral role.
 *
 * Sets up GATT services matching the real Millennium board and starts advertising.
 *
 * @param rx_callback Callback for data received from chess app
 * @return 0 on success, negative errno on failure
 */
int ble_peripheral_init(peripheral_rx_callback_t rx_callback);

/**
 * Start advertising.
 *
 * Makes the proxy visible to chess apps as "MILLENNIUM CHESS".
 *
 * @return 0 on success, negative errno on failure
 */
int ble_peripheral_start_advertising(void);

/**
 * Stop advertising.
 *
 * @return 0 on success, negative errno on failure
 */
int ble_peripheral_stop_advertising(void);

/**
 * Check if a chess app is connected.
 *
 * @return true if an app is connected to the peripheral
 */
bool ble_peripheral_is_connected(void);

/**
 * Send data to connected chess app.
 *
 * Sends data via TX characteristic notification.
 * This is used to forward responses from the real board to the app.
 *
 * @param data Pointer to data buffer
 * @param len Length of data
 * @return 0 on success, negative errno on failure
 */
int ble_peripheral_send(const uint8_t *data, size_t len);

/**
 * Disconnect from chess app.
 *
 * @return 0 on success, negative errno on failure
 */
int ble_peripheral_disconnect(void);

#endif /* BLE_PERIPHERAL_H */
```

## src/protocol.c
```c
/**
 * @file protocol.c
 * @brief Millennium protocol decoding for human-readable output
 *
 * Decodes Millennium ChessLink protocol messages for display on the
 * USB console. This provides insight into what commands the app sends
 * and what responses the board returns.
 */

#include "protocol.h"
#include "usb_console.h"

#include <zephyr/logging/log.h>
#include <stdio.h>
#include <string.h>
#include <ctype.h>

LOG_MODULE_REGISTER(protocol, LOG_LEVEL_INF);

/**
 * Decode and log a Millennium protocol message.
 *
 * The Millennium protocol uses ASCII characters with 7-bit parity:
 * - Each byte has parity in MSB (bit 7)
 * - Command format: [parity_bytes...] [crc]
 * - Commands: V (version), S (board state), L (LED), X (LED off), etc.
 * - Responses: v (version), s (board state 64 chars), r (ack)
 *
 * @param dir Traffic direction
 * @param data Raw data buffer
 * @param len Data length
 */
void protocol_decode_and_log(traffic_dir_t dir, const uint8_t *data, size_t len)
{
    if (len == 0) {
        return;
    }
    
    char msg[256];
    int pos = 0;
    
    /* Extract command byte (strip parity) */
    uint8_t cmd = data[0] & 0x7F;
    
    /* Check if this looks like a Millennium protocol message */
    if (!isprint(cmd) && cmd != '\r' && cmd != '\n') {
        /* Not ASCII - just show raw hex */
        pos = snprintf(msg, sizeof(msg), "RAW[%zu]: ", len);
        for (size_t i = 0; i < len && pos < (int)sizeof(msg) - 4; i++) {
            pos += snprintf(msg + pos, sizeof(msg) - pos, "%02x ", data[i]);
        }
        usb_console_log_decoded(dir, msg);
        return;
    }
    
    /* Decode based on command type */
    switch (cmd) {
    case 'V':
        snprintf(msg, sizeof(msg), "CMD: VERSION request");
        break;
    
    case 'v':
        /* Version response - payload is version string */
        if (len > 2) {
            char version[64];
            size_t vlen = 0;
            for (size_t i = 1; i < len - 1 && vlen < sizeof(version) - 1; i++) {
                version[vlen++] = data[i] & 0x7F;
            }
            version[vlen] = '\0';
            snprintf(msg, sizeof(msg), "RESP: VERSION = \"%s\"", version);
        } else {
            snprintf(msg, sizeof(msg), "RESP: VERSION (empty)");
        }
        break;
    
    case 'S':
        snprintf(msg, sizeof(msg), "CMD: BOARD STATE request");
        break;
    
    case 's':
        /* Board state response - 64 chars for squares */
        if (len >= 66) {  /* 's' + 64 squares + crc */
            pos = snprintf(msg, sizeof(msg), "RESP: BOARD STATE\n");
            
            /* Format as 8x8 board */
            for (int rank = 7; rank >= 0; rank--) {
                pos += snprintf(msg + pos, sizeof(msg) - pos, "    %d: ", rank + 1);
                for (int file = 0; file < 8; file++) {
                    int idx = rank * 8 + file + 1;  /* +1 for 's' prefix */
                    char sq = data[idx] & 0x7F;
                    pos += snprintf(msg + pos, sizeof(msg) - pos, "%c ", sq);
                }
                pos += snprintf(msg + pos, sizeof(msg) - pos, "\n");
            }
            pos += snprintf(msg + pos, sizeof(msg) - pos, "       a b c d e f g h");
        } else {
            snprintf(msg, sizeof(msg), "RESP: BOARD STATE (%zu bytes, expected 66)", len);
        }
        break;
    
    case 'L':
        /* LED command */
        if (len >= 3) {
            uint8_t square = data[1] & 0x7F;
            uint8_t state = data[2] & 0x7F;
            int file = (square % 9);
            int rank = (square / 9);
            snprintf(msg, sizeof(msg), "CMD: LED square=%d (%c%d) state=%c",
                     square, 
                     (file >= 1 && file <= 8) ? ('a' + file - 1) : '?',
                     rank,
                     state);
        } else {
            snprintf(msg, sizeof(msg), "CMD: LED (incomplete)");
        }
        break;
    
    case 'X':
        snprintf(msg, sizeof(msg), "CMD: ALL LEDs OFF");
        break;
    
    case 'R':
        snprintf(msg, sizeof(msg), "CMD: RESET");
        break;
    
    case 'r':
        snprintf(msg, sizeof(msg), "RESP: ACK");
        break;
    
    case 'B':
        snprintf(msg, sizeof(msg), "CMD: BEEP");
        break;
    
    case 'W':
        snprintf(msg, sizeof(msg), "CMD: SCAN ON (enable board scanning)");
        break;
    
    case 'I':
        snprintf(msg, sizeof(msg), "CMD: SCAN OFF (disable board scanning)");
        break;
    
    default:
        /* Unknown command - show ASCII and hex */
        if (isprint(cmd)) {
            pos = snprintf(msg, sizeof(msg), "CMD: '%c' (0x%02x) [", cmd, cmd);
        } else {
            pos = snprintf(msg, sizeof(msg), "CMD: 0x%02x [", cmd);
        }
        
        /* Show payload as ASCII where printable */
        for (size_t i = 0; i < len && pos < (int)sizeof(msg) - 4; i++) {
            char c = data[i] & 0x7F;
            if (isprint(c)) {
                pos += snprintf(msg + pos, sizeof(msg) - pos, "%c", c);
            } else {
                pos += snprintf(msg + pos, sizeof(msg) - pos, "\\x%02x", data[i]);
            }
        }
        pos += snprintf(msg + pos, sizeof(msg) - pos, "]");
        break;
    }
    
    usb_console_log_decoded(dir, msg);
}

/**
 * Validate Millennium protocol CRC.
 *
 * @param data Data buffer including CRC byte at end
 * @param len Total length including CRC
 * @return true if CRC is valid
 */
bool protocol_validate_crc(const uint8_t *data, size_t len)
{
    if (len < 2) {
        return false;
    }
    
    uint8_t crc = millennium_crc(data, len - 1);
    return (crc == data[len - 1]);
}
```

## src/protocol.h
```c
/**
 * @file protocol.h
 * @brief Millennium ChessLink protocol definitions
 *
 * Defines the BLE UUIDs, command types, and protocol structures for the
 * Millennium ChessLink board. Based on protocol analysis from the existing
 * DGTCentaurMods simulator implementation.
 */

#ifndef PROTOCOL_H
#define PROTOCOL_H

#include <zephyr/bluetooth/uuid.h>
#include <stdbool.h>
#include <stddef.h>
#include <stdint.h>
#include "usb_console.h"

/*
 * Millennium ChessLink BLE Service and Characteristic UUIDs
 *
 * The service uses a custom 128-bit UUID with 5 characteristics:
 * - Config: READ/WRITE configuration
 * - Notify1: WRITE/NOTIFY
 * - TX: READ/WRITE/WRITE_NO_RESP/NOTIFY (main data from board)
 * - RX: WRITE/WRITE_NO_RESP (main data to board)
 * - Notify2: WRITE/NOTIFY
 */

/* Millennium Service UUID: 49535343-fe7d-4ae5-8fa9-9fafd205e455 */
#define MILLENNIUM_SERVICE_UUID \
    BT_UUID_128_ENCODE(0x49535343, 0xfe7d, 0x4ae5, 0x8fa9, 0x9fafd205e455)

/* Config Characteristic: 49535343-6daa-4d02-abf6-19569aca69fe */
#define MILLENNIUM_CONFIG_UUID \
    BT_UUID_128_ENCODE(0x49535343, 0x6daa, 0x4d02, 0xabf6, 0x19569aca69fe)

/* Notify1 Characteristic: 49535343-aca3-481c-91ec-d85e28a60318 */
#define MILLENNIUM_NOTIFY1_UUID \
    BT_UUID_128_ENCODE(0x49535343, 0xaca3, 0x481c, 0x91ec, 0xd85e28a60318)

/* TX Characteristic: 49535343-1e4d-4bd9-ba61-23c647249616 */
#define MILLENNIUM_TX_UUID \
    BT_UUID_128_ENCODE(0x49535343, 0x1e4d, 0x4bd9, 0xba61, 0x23c647249616)

/* RX Characteristic: 49535343-8841-43f4-a8d4-ecbe34729bb3 */
#define MILLENNIUM_RX_UUID \
    BT_UUID_128_ENCODE(0x49535343, 0x8841, 0x43f4, 0xa8d4, 0xecbe34729bb3)

/* Notify2 Characteristic: 49535343-026e-3a9b-954c-97daef17e26e */
#define MILLENNIUM_NOTIFY2_UUID \
    BT_UUID_128_ENCODE(0x49535343, 0x026e, 0x3a9b, 0x954c, 0x97daef17e26e)

/* Declare UUID structures */
#define BT_UUID_MILLENNIUM_SERVICE BT_UUID_DECLARE_128(MILLENNIUM_SERVICE_UUID)
#define BT_UUID_MILLENNIUM_CONFIG  BT_UUID_DECLARE_128(MILLENNIUM_CONFIG_UUID)
#define BT_UUID_MILLENNIUM_NOTIFY1 BT_UUID_DECLARE_128(MILLENNIUM_NOTIFY1_UUID)
#define BT_UUID_MILLENNIUM_TX      BT_UUID_DECLARE_128(MILLENNIUM_TX_UUID)
#define BT_UUID_MILLENNIUM_RX      BT_UUID_DECLARE_128(MILLENNIUM_RX_UUID)
#define BT_UUID_MILLENNIUM_NOTIFY2 BT_UUID_DECLARE_128(MILLENNIUM_NOTIFY2_UUID)

/*
 * Millennium Protocol Commands
 *
 * Commands use ASCII characters with 7-bit parity and XOR CRC.
 * Format: <parity_byte> <command_char> [payload...] <crc>
 */

/* Command types (ASCII characters) */
#define CMD_VERSION     'V'  /* Request version info */
#define CMD_BOARD_STATE 'S'  /* Request board state */
#define CMD_LED_SET     'L'  /* Set LEDs */
#define CMD_LED_OFF     'X'  /* All LEDs off */
#define CMD_RESET       'R'  /* Reset board */
#define CMD_BEEP        'B'  /* Beep */
#define CMD_SCAN_ON     'W'  /* Enable scanning */
#define CMD_SCAN_OFF    'I'  /* Disable scanning */

/* Response types */
#define RESP_VERSION    'v'  /* Version response */
#define RESP_BOARD      's'  /* Board state (64 chars) */
#define RESP_OK         'r'  /* Command acknowledged */

/**
 * Calculate XOR CRC for Millennium protocol.
 *
 * @param data Pointer to data buffer
 * @param len Length of data
 * @return XOR of all bytes
 */
static inline uint8_t millennium_crc(const uint8_t *data, size_t len)
{
    uint8_t crc = 0;
    for (size_t i = 0; i < len; i++) {
        crc ^= data[i];
    }
    return crc;
}

/**
 * Add 7-bit parity to a byte.
 *
 * @param byte Input byte (7-bit value)
 * @return Byte with parity bit set in MSB
 */
static inline uint8_t add_parity(uint8_t byte)
{
    uint8_t parity = 0;
    uint8_t val = byte & 0x7F;
    
    /* Count set bits */
    for (int i = 0; i < 7; i++) {
        if (val & (1 << i)) {
            parity ^= 1;
        }
    }
    
    /* Set parity bit (MSB) for even parity */
    return (parity ? (byte | 0x80) : (byte & 0x7F));
}

/**
 * Check parity of a byte.
 *
 * @param byte Input byte with parity
 * @return true if parity is valid
 */
static inline bool check_parity(uint8_t byte)
{
    uint8_t count = 0;
    for (int i = 0; i < 8; i++) {
        if (byte & (1 << i)) {
            count++;
        }
    }
    return (count % 2) == 0;
}

/**
 * Decode and log a Millennium protocol message.
 *
 * @param dir Traffic direction
 * @param data Raw data buffer
 * @param len Data length
 */
void protocol_decode_and_log(traffic_dir_t dir, const uint8_t *data, size_t len);

/**
 * Validate Millennium protocol CRC.
 *
 * @param data Data buffer including CRC byte at end
 * @param len Total length including CRC
 * @return true if CRC is valid
 */
bool protocol_validate_crc(const uint8_t *data, size_t len);

#endif /* PROTOCOL_H */
```

## src/usb_console.c
```c
/**
 * @file usb_console.c
 * @brief USB CDC console implementation
 *
 * Streams timestamped protocol traffic over USB CDC for host analysis.
 */

#include "usb_console.h"

#include <zephyr/kernel.h>
#include <zephyr/device.h>
#include <zephyr/drivers/uart.h>
#include <zephyr/logging/log.h>

#include <stdio.h>
#include <stdarg.h>
#include <string.h>

LOG_MODULE_REGISTER(usb_console, LOG_LEVEL_INF);

/* USB CDC device */
static const struct device *cdc_dev;
static bool usb_ready = false;

/* Output buffer for formatting */
#define OUTPUT_BUF_SIZE 512
static char output_buf[OUTPUT_BUF_SIZE];
static struct k_mutex output_mutex;

/**
 * Get timestamp string in HH:MM:SS.mmm format.
 *
 * Uses uptime since we don't have RTC. Hours wrap at 24.
 */
static void get_timestamp(char *buf, size_t len)
{
    uint32_t uptime_ms = k_uptime_get_32();
    uint32_t ms = uptime_ms % 1000;
    uint32_t sec = (uptime_ms / 1000) % 60;
    uint32_t min = (uptime_ms / 60000) % 60;
    uint32_t hr = (uptime_ms / 3600000) % 24;
    
    snprintf(buf, len, "%02u:%02u:%02u.%03u", hr, min, sec, ms);
}

/**
 * Write string to USB CDC.
 */
static void cdc_write_string(const char *str)
{
    if (!usb_ready || !cdc_dev) {
        return;
    }
    
    size_t len = strlen(str);
    
    for (size_t i = 0; i < len; i++) {
        uart_poll_out(cdc_dev, str[i]);
    }
}

int usb_console_init(void)
{
    k_mutex_init(&output_mutex);
    
    /* Get CDC ACM device */
    cdc_dev = DEVICE_DT_GET_ONE(zephyr_cdc_acm_uart);
    if (!device_is_ready(cdc_dev)) {
        LOG_ERR("CDC ACM device not ready");
        return -ENODEV;
    }
    
    /* Wait for USB to be configured */
    k_sleep(K_MSEC(1000));
    
    usb_ready = true;
    LOG_INF("USB CDC console initialized");
    
    /* Print startup banner */
    usb_console_log_status("Millennium BLE Proxy initialized");
    usb_console_log_status("Waiting for connections...");
    
    return 0;
}

void usb_console_log_traffic(traffic_dir_t dir, const uint8_t *data, size_t len)
{
    if (!usb_ready || len == 0) {
        return;
    }
    
    k_mutex_lock(&output_mutex, K_FOREVER);
    
    char timestamp[16];
    get_timestamp(timestamp, sizeof(timestamp));
    
    const char *dir_str = (dir == DIR_APP_TO_BOARD) ? "APP->BOARD" : "BOARD->APP";
    
    /* Format: [HH:MM:SS.mmm] DIR: xx xx xx ... */
    int pos = snprintf(output_buf, OUTPUT_BUF_SIZE, "[%s] %s:", timestamp, dir_str);
    
    /* Append hex bytes */
    for (size_t i = 0; i < len && pos < OUTPUT_BUF_SIZE - 4; i++) {
        pos += snprintf(output_buf + pos, OUTPUT_BUF_SIZE - pos, " %02x", data[i]);
    }
    
    /* Add newline */
    if (pos < OUTPUT_BUF_SIZE - 2) {
        output_buf[pos++] = '\r';
        output_buf[pos++] = '\n';
        output_buf[pos] = '\0';
    }
    
    cdc_write_string(output_buf);
    
    k_mutex_unlock(&output_mutex);
}

void usb_console_log_decoded(traffic_dir_t dir, const char *msg)
{
    if (!usb_ready) {
        return;
    }
    
    k_mutex_lock(&output_mutex, K_FOREVER);
    
    char timestamp[16];
    get_timestamp(timestamp, sizeof(timestamp));
    
    const char *dir_str = (dir == DIR_APP_TO_BOARD) ? "APP->BOARD" : "BOARD->APP";
    
    snprintf(output_buf, OUTPUT_BUF_SIZE, "[%s] %s: %s\r\n", timestamp, dir_str, msg);
    cdc_write_string(output_buf);
    
    k_mutex_unlock(&output_mutex);
}

void usb_console_log_status(const char *msg)
{
    if (!usb_ready) {
        return;
    }
    
    k_mutex_lock(&output_mutex, K_FOREVER);
    
    char timestamp[16];
    get_timestamp(timestamp, sizeof(timestamp));
    
    snprintf(output_buf, OUTPUT_BUF_SIZE, "[%s] STATUS: %s\r\n", timestamp, msg);
    cdc_write_string(output_buf);
    
    k_mutex_unlock(&output_mutex);
}

void usb_console_printf(const char *fmt, ...)
{
    if (!usb_ready) {
        return;
    }
    
    k_mutex_lock(&output_mutex, K_FOREVER);
    
    va_list args;
    va_start(args, fmt);
    vsnprintf(output_buf, OUTPUT_BUF_SIZE, fmt, args);
    va_end(args);
    
    cdc_write_string(output_buf);
    
    k_mutex_unlock(&output_mutex);
}
```
